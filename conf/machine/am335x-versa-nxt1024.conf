## conf/machine/am335x-versa-nxt1024.conf
```bitbake
#@TYPE: Machine
#@NAME: am335x-versa-nxt1024
#@DESCRIPTION: Machine configuration for system with am335x-versa-nxt som 1024MB DDR

MACHINE_EXTRA_RRECOMMENDS = "kernel-modules kernel-devicetree"

EXTRA_IMAGEDEPENDS += "u-boot-calixto-ti"

DEFAULTTUNE ?= "cortexa8hf-neon"
include conf/machine/include/arm/armv7a/tune-cortexa8.inc

IMAGE_FSTYPES += "tar"

IMAGE_INSTALL:append = " am335x-versa-flasher"

MACHINE_ESSENTIAL_EXTRA_RDEPENDS += "kernel-image kernel-devicetree"

SERIAL_CONSOLES ?= "115200;ttyS0 115200;ttyO0"
SERIAL_CONSOLES_CHECK = "${SERIAL_CONSOLES}"

PREFERRED_PROVIDER_virtual/kernel ?= "linux-calixto-ti"

PREFERRED_PROVIDER_virtual/bootloader = "u-boot-calixto-ti"
PREFERRED_PROVIDER_u-boot = "u-boot-calixto-ti"

KERNEL_IMAGETYPE = "zImage"
KERNEL_DEVICETREE = "am335x-calixto-nxt.dtb"

KERNEL_EXTRA_ARGS += "LOADADDR=${UBOOT_ENTRYPOINT}"

SPL_BINARY = "MLO"
SPL_SPI_BINARY = "MLO.byteswap"
UBOOT_SUFFIX = "img"
UBOOT_MACHINE = "am335x_versa_nxt256_defconfig"
UBOOT_ENTRYPOINT = "0x80008000"
UBOOT_LOADADDRESS = "0x80008000"

MACHINE_FEATURES = "usbgadget usbhost vfat alsa"
 
IMAGE_BOOT_FILES ?= "MLO zImage am335x-calixto-nxt.dtb u-boot.${UBOOT_SUFFIX}"

require create-calixto-image.inc
IMAGE_POSTPROCESS_COMMAND += "create_am335x_versa_image; "
```

## conf/machine/create-calixto-image.inc
```bitbake
create_am335x_versa_image () {

CALIXTO_IMAGE_PATH_SDCARD="${DEPLOY_DIR}/../../../calixto-images/${MACHINE}/sdcard"

rm -rf ${CALIXTO_IMAGE_PATH_SDCARD}
mkdir -p ${CALIXTO_IMAGE_PATH_SDCARD}

cp ${DEPLOY_DIR}/../../../meta-calixto-ti/recipes-bsp/am335x-versa-flasher/files/MLO ${CALIXTO_IMAGE_PATH_SDCARD}/MLO
cp ${DEPLOY_DIR}/../../../meta-calixto-ti/recipes-bsp/am335x-versa-flasher/files/MLO.byteswap ${CALIXTO_IMAGE_PATH_SDCARD}/MLO.byteswap
cp ${DEPLOY_DIR}/../../../meta-calixto-ti/recipes-bsp/am335x-versa-flasher/files/u-boot.img ${CALIXTO_IMAGE_PATH_SDCARD}/u-boot.img

cp ${DEPLOY_DIR}/../../../meta-calixto-ti/recipes-bsp/am335x-versa-flasher/files/create-sdcard-boot.sh ${CALIXTO_IMAGE_PATH_SDCARD}/create-sdcard-boot.sh

}
```
